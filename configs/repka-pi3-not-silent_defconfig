## configs/repka-pi3-not-silent_defconfig
```kconfig
CONFIG_ARM=y
CONFIG_ARCH_SUNXI=y
CONFIG_DEFAULT_DEVICE_TREE="sun50i-h5-repka-pi3-1ghz"
CONFIG_SPL=y
CONFIG_MACH_SUN50I_H5=y
CONFIG_DRAM_CLK=672
CONFIG_DRAM_ZQ=3881977
CONFIG_SYS_CLK_FREQ=648000000
CONFIG_SPL_SPI_SUNXI=y
CONFIG_DRAM_ODT_EN=y
CONFIG_SPL_I2C=y
CONFIG_SYS_I2C_MVTWSI=y
CONFIG_SUN8I_EMAC=y
CONFIG_USB_EHCI_HCD=y
CONFIG_USB_OHCI_HCD=y
CONFIG_VIDEO=y
CONFIG_VIDEO_LOGO=n
```

## configs/repka-pi3-silent_defconfig
```kconfig
CONFIG_ARM=y
CONFIG_ARCH_SUNXI=y
CONFIG_DEFAULT_DEVICE_TREE="sun50i-h5-repka-pi3-1ghz"
CONFIG_SPL=y
CONFIG_MACH_SUN50I_H5=y
CONFIG_DRAM_CLK=672
CONFIG_DRAM_ZQ=3881977
CONFIG_SYS_CLK_FREQ=648000000
CONFIG_VIDEO_DE2=n
CONFIG_SPL_SPI_SUNXI=y
CONFIG_DRAM_ODT_EN=y
CONFIG_SPL_I2C=y
CONFIG_SYS_I2C_MVTWSI=y
CONFIG_SUN8I_EMAC=y
CONFIG_USB_EHCI_HCD=y
CONFIG_USB_OHCI_HCD=y

# uboot and spl logoff
CONFIG_BOOTDELAY=-2
CONFIG_SILENT_CONSOLE=y
CONFIG_SYS_DEVICE_NULLDEV=y
CONFIG_SILENT_CONSOLE_UPDATE_ON_SET=y
CONFIG_SILENT_U_BOOT_ONLY=y
CONFIG_SPL_SILENT_CONSOLE=y
CONFIG_SPL_BANNER_PRINT=n
CONFIG_FORCE_DISABLE_CONSOLE=y
```

## configs/repka_pi3_defconfig
```kconfig
CONFIG_ARM=y
CONFIG_ARCH_SUNXI=y
CONFIG_DEFAULT_DEVICE_TREE="sun50i-h5-repka-pi3"
CONFIG_SPL=y
CONFIG_MACH_SUN50I_H5=y
#CONFIG_DRAM_CLK=504
CONFIG_DRAM_CLK=672
#CONFIG_DRAM_CLK=696
#CONFIG_DRAM_CLK=744
#CONFIG_DRAM_CLK=768
CONFIG_DRAM_ZQ=3881977
CONFIG_SYS_CLK_FREQ=312000000
CONFIG_SPL_SPI_SUNXI=y
# CONFIG_DRAM_ODT_EN is not set
# CONFIG_SYS_MALLOC_CLEAR_ON_INIT is not set
CONFIG_SPL_I2C=y
CONFIG_SYS_I2C_MVTWSI=y
CONFIG_SUN8I_EMAC=y
CONFIG_USB_EHCI_HCD=y
CONFIG_USB_OHCI_HCD=y
# CONFIG_USB_MUSB_GADGET=y
# uboot logoff
#CONFIG_VIDEO_DE2=n
#CONFIG_BOOTDELAY=-2
#CONFIG_SILENT_CONSOLE=y
#CONFIG_SYS_DEVICE_NULLDEV=y
#CONFIG_SILENT_CONSOLE_UPDATE_ON_SET=y
#CONFIG_SILENT_U_BOOT_ONLY=y
```
