/dts-v1/;
/plugin/;

/ {
	fragment@0 {
		target = <&i2c1>;
		__overlay__ {
			pinctrl-names = "default";
			pinctrl-0 = <&i2c1_pins_up>;
			status = "okay";
		};
	};

	fragment@1 {
		target = <&pio>;
		__overlay__ {
			spi0_cs1: spi0_cs1 {
				pins = "PA3";
				function = "gpio_out";
				output-high;
			};

			i2c1_pins_up: i2c1_pins_up {
				pins = "PA18", "PA19";
				function = "i2c1";
				bias-pull-up;
			};
		};
	};
};