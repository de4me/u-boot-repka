/dts-v1/;
/plugin/;

/ {
    fragment@0 {
        target = <&spi1>;
        __overlay__ {
            pinctrl-names = "default", "default";
            status = "okay";
            spidev@0 {
                compatible = "rohm,dh2228fv";
                status = "okay";
                reg = <0>;
                spi-max-frequency = <1000000>;
            };
        };
    };
};